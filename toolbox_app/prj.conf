## CMakeLists.txt
```
# SPDX-License-Identifier: Apache-2.0

cmake_minimum_required(VERSION 3.13.1)

find_package(Zephyr REQUIRED HINTS $ENV{ZEPHYR_BASE})
project(toolbox_app)

target_sources(app PRIVATE src/main.c)

set(gen_dir ${ZEPHYR_BINARY_DIR}/include/generated/)

foreach(inc_file
	ca.der
	server.der
	server_privkey.der
	echo-apps-cert.der
	echo-apps-key.der
    )
  generate_inc_file_for_target(
    app
    src/${inc_file}
    ${gen_dir}/${inc_file}.inc
    )
endforeach()

zephyr_include_directories(
        $ENV{ZEPHYR_BASE}/subsys/net/ip
        )
```

## prj.conf
```kconfig
CONFIG_LOG=y


CONFIG_NETWORKING=y
CONFIG_NET_UDP=y
CONFIG_NET_TCP=y
CONFIG_NET_IPV6=y
CONFIG_NET_IPV4=y
CONFIG_NET_L2_ETHERNET=y

CONFIG_NET_SOCKETS=y
CONFIG_NET_SOCKETS_POSIX_NAMES=y
CONFIG_NET_SOCKETS_POLL_MAX=4
# TLS/DTLS
CONFIG_NET_SOCKETS_SOCKOPT_TLS=y
CONFIG_NET_SOCKETS_TLS_MAX_CONTEXTS=6
CONFIG_NET_SOCKETS_ENABLE_DTLS=y
CONFIG_NET_SOCKETS_DTLS_TIMEOUT=30000
CONFIG_MBEDTLS=y
CONFIG_MBEDTLS_BUILTIN=y
CONFIG_MBEDTLS_ENABLE_HEAP=y
CONFIG_MBEDTLS_HEAP_SIZE=60000
CONFIG_MBEDTLS_SSL_MAX_CONTENT_LEN=2048

CONFIG_NET_SHELL=y
CONFIG_NET_STATISTICS=y

CONFIG_NET_CONFIG_SETTINGS=y
CONFIG_NET_CONFIG_MY_IPV6_ADDR="2001:db8::2"
CONFIG_NET_CONFIG_PEER_IPV6_ADDR="2001:db8::1"
CONFIG_NET_CONFIG_MY_IPV4_ADDR="192.0.2.2"
CONFIG_NET_CONFIG_PEER_IPV4_ADDR="192.0.2.1"

CONFIG_ETH_NATIVE_POSIX=y

CONFIG_NET_LOG=y
CONFIG_LOG_DEFAULT_LEVEL=4
CONFIG_NET_SOCKETS_LOG_LEVEL_DBG=y
CONFIG_NET_PKT_LOG_LEVEL_INF=y
```

## src/main.c
```c
/*
 * Copyright (c) 2020 Léonard Bise
 *
 * SPDX-License-Identifier: Apache-2.0
 */
#include <logging/log.h>
LOG_MODULE_REGISTER(toolbox, LOG_LEVEL_DBG);

#include <zephyr.h>
#include <stdio.h>
#include <shell/shell.h>
#include <net/socket.h>
#include <net/tls_credentials.h>
#include "net_private.h"

/* Use signed certificates */
#define SIGNED_CERTS
#include "certificate.h"

#define RECV_BUF_SIZE 1024
#define MAX_NB_POLL 10
#define MSG_SIZE 256

static int cmd_sock_new(const struct shell *shell, size_t argc, char *argv[])
{
	/* sock new <family> <type> <proto> */
	int arg = 1;
	int fd;
	int family;
	int type;
	int proto;

	if (argc < 4) {
		return -ENOEXEC;
	}

	if (strncmp(argv[arg], "inet", 5) == 0) {
		family = AF_INET;
	} else if (strncmp(argv[arg], "inet6", 6) == 0) {
		family = AF_INET6;
	} else {
		LOG_ERR("Unsupported socket family %s", argv[arg]);
		return -ENOEXEC;
	}

	arg++;

	if (strncmp(argv[arg], "stream", 6) == 0) {
		type = SOCK_STREAM;
	} else if (strncmp(argv[arg], "dgram", 5) == 0) {
		type = SOCK_DGRAM;
	} else {
		LOG_ERR("Unsupported socket type %s", argv[arg]);
		return -ENOEXEC;
	}

	arg++;

	if (strncmp(argv[arg], "tcp", 3) == 0) {
		proto = IPPROTO_TCP;
	} else if (strncmp(argv[arg], "tls_1_2", 5) == 0) {
		proto = IPPROTO_TLS_1_2;
	} else {
		LOG_ERR("Unsupported socket proto %s", argv[arg]);
		return -ENOEXEC;
	}

	arg++;

	fd = socket(family, type, proto);
	if (fd < 0) {
		LOG_ERR("Cannot create new socket %d", errno);
		return errno;
	}

	LOG_INF("Created socket fd=%d", fd);

	return 0;
}

static int cmd_sock_connect(const struct shell *shell, size_t argc, char *argv[])
{
	/* sock connect <fd> <ip>:<port> or [<ipv6>]:port */
	int arg = 1;
	int fd;
	struct sockaddr addr;
	const char *addr_str;
	int err;

	if (argc < 3) {
		return -ENOEXEC;
	}

	fd = strtoul(argv[arg++], NULL, 10);

	addr_str = argv[arg++];
	if (!net_ipaddr_parse(addr_str, strnlen(addr_str, NET_IPV6_ADDR_LEN),
			     &addr)) {
		LOG_ERR("Cannot parse ip and port: %s", addr_str);
		return -ENOEXEC;
	}

	err = connect(fd, &addr, sizeof(addr));
	if (err) {
		LOG_ERR("Cannot connect to %s (%d)", addr_str, -errno);
		return -ENOEXEC;
	}

	LOG_INF("Connected fd=%d to %s", fd, addr_str);

	return 0;
}

static int cmd_sock_bind(const struct shell *shell, size_t argc, char *argv[])
{
	/* sock bind <fd> <ip>:<port> or [<ipv6>]:port */
	int arg = 1;
	int fd;
	struct sockaddr addr;
	const char *addr_str;
	int err;

	if (argc < 3) {
		return -ENOEXEC;
	}

	fd = strtoul(argv[arg++], NULL, 10);

	addr_str = argv[arg++];
	if (!net_ipaddr_parse(addr_str, strnlen(addr_str, NET_IPV6_ADDR_LEN),
			     &addr)) {
		LOG_ERR("Cannot parse ip and port: %s", addr_str);
		return -ENOEXEC;
	}

	err = bind(fd, &addr, sizeof(addr));
	if (err) {
		LOG_ERR("Cannot bind to %s (%d)", addr_str, -errno);
		return -ENOEXEC;
	}

	return 0;
}

static int cmd_sock_listen(const struct shell *shell, size_t argc, char *argv[])
{
	/* sock listen <fd> <max client> */
	int arg = 1;
	int fd;
	int max;
	int err;

	if (argc < 3) {
		return -ENOEXEC;
	}

	fd = strtoul(argv[arg++], NULL, 10);

	max = strtoul(argv[arg++], NULL, 10);

	err = listen(fd, max);
	if (err) {
		LOG_ERR("Cannot listen (%d)", -errno);
		return -ENOEXEC;
	}

	return 0;
}

static int cmd_sock_accept(const struct shell *shell, size_t argc, char *argv[])
{
	/* sock accept <fd> */
	int arg = 1;
	int fd;
	struct sockaddr client_addr;
	socklen_t client_addr_len = sizeof(client_addr);
	int err;

	if (argc < 2) {
		return -ENOEXEC;
	}

	fd = strtoul(argv[arg++], NULL, 10);

	err = accept(fd, &client_addr, &client_addr_len);
	if (err < 0) {
		LOG_ERR("Cannot accept client (%d)", -errno);
		return -ENOEXEC;
	}

	if (client_addr.sa_family == AF_INET) {
		LOG_INF("New client fd=%d %s:%d", err,
			log_strdup(net_sprint_ipv4_addr(
					&net_sin(&client_addr)->sin_addr)),
			ntohs(net_sin(&client_addr)->sin_port));
	} else if (client_addr.sa_family == AF_INET6) {
		LOG_INF("New client fd=%d [%s]:%d", err,
			log_strdup(net_sprint_ipv6_addr(
					&net_sin6(&client_addr)->sin6_addr)),
				   ntohs(net_sin6(&client_addr)->sin6_port));
	}

	return 0;
}


static int cmd_sock_close(const struct shell *shell, size_t argc, char *argv[])
{
	/* sock close <fd> */
	int arg = 1;
	int fd;
	int err;

	if (argc < 2) {
		return -ENOEXEC;
	}

	fd = strtoul(argv[arg++], NULL, 10);

	err = close(fd);
	if (err) {
		LOG_ERR("Cannot close (%d)", -errno);
		return -ENOEXEC;
	}

	return 0;
}

static ssize_t sendall(int sock, const void *buf, size_t len)
{
	while (len) {
		ssize_t out_len = send(sock, buf, len, 0);

		if (out_len < 0) {
			return out_len;
		}
		buf = (const char *)buf + out_len;
		len -= out_len;
	}

	return 0;
}

static int cmd_sock_send(const struct shell *shell, size_t argc, char *argv[])
{
	/* sock send <fd> <data> */
	int arg = 1;
	int fd;
	ssize_t size;

	if (argc < 3) {
		return -ENOEXEC;
	}

	fd = strtoul(argv[arg++], NULL, 10);

	LOG_INF("Sending %d bytes to fd=%d", strlen(argv[arg]), fd);
	size = sendall(fd, argv[arg], strlen(argv[arg]));
	if (size < 0) {
		LOG_ERR("Cannot send (%d)", size);
		return -ENOEXEC;
	}

	return 0;
}

static int cmd_sock_recv(const struct shell *shell, size_t argc, char *argv[])
{
	/* sock recv <fd> */
	int arg = 1;
	int fd;
	ssize_t size;
	static uint8_t buf[RECV_BUF_SIZE];

	if (argc < 2) {
		return -ENOEXEC;
	}

	fd = strtoul(argv[arg++], NULL, 10);

	size = recv(fd, buf, sizeof(buf) - 1, 0);
	if (size < 0) {
		LOG_ERR("Cannot receive (%d)", size);
		return -ENOEXEC;
	}

	/* Ensure buffer is NULL terminated */
	buf[size] = '\0';

	LOG_INF("Received %d bytes from fd=%d", size, fd);

	shell_print(shell, "\"%s\"", buf);
	shell_hexdump(shell, buf, size);

	return 0;
}

static int cmd_sock_poll(const struct shell *shell, size_t argc, char *argv[])
{
	/* sock poll <timeout> <in|inout|out> <nfd> <fd1> <fd2> ..<fdn> */
	int arg = 1;
	int nfd;
	int timeout;
	int events = POLLERR | POLLHUP | POLLNVAL;
	struct pollfd pollfds[MAX_NB_POLL];
	int err;

	if (argc < 5) {
		return -ENOEXEC;
	}

	timeout = strtoul(argv[arg++], NULL, 10);

	if (strncmp(argv[arg], "inout", 5) == 0) {
		events |= POLLIN;
		events |= POLLOUT;
	} else if (strncmp(argv[arg], "in", 2) == 0) {
		events |= POLLIN;
	} else if (strncmp(argv[arg], "out", 2) == 0) {
		events |= POLLOUT;
	}

	arg++;

	nfd = strtoul(argv[arg++], NULL, 10);
	if ((nfd + 4) != argc) {
		LOG_ERR("Invalid number of parameters provided");
		return -ENOEXEC;
	}

	for (int i = 0; i < nfd; i++) {
		pollfds[i].fd = strtoul(argv[arg++], NULL, 10);
		pollfds[i].events = events;
	}

	LOG_INF("Polling %d file descriptors for 0x%x", nfd, events);

	err = poll(pollfds, nfd, timeout);
	if (err < 0) {
		LOG_ERR("Cannot poll (%d)", -errno);
		return -errno;
	}

	for (int i = 0; i < nfd; i++) {
		LOG_INF("fd=%d events=0x%x revents=0x%x", pollfds[i].fd,
			pollfds[i].events,
			pollfds[i].revents);
	}

	return 0;
}

static int cmd_sock_tlsopt(const struct shell *shell, size_t argc, char *argv[])
{
#if defined(CONFIG_NET_SOCKETS_SOCKOPT_TLS)
	/* sock tlsopt <fd> <srv|cli> */
	int arg = 1;
	int fd;
	bool srv;
	int err;

	if (argc < 3) {
		return -ENOEXEC;
	}

	fd = strtoul(argv[arg++], NULL, 10);

	if (strncmp(argv[arg], "srv", 3) == 0) {
		srv = true;
	} else if (strncmp(argv[arg], "cli", 3) == 0) {
		srv = false;
	} else {
		LOG_ERR("Unknown type %s", argv[arg]);
		return -ENOEXEC;
	}

	sec_tag_t sec_tag_list[] = {
		CERTIFICATE_TAG,
#if defined(CONFIG_MBEDTLS_KEY_EXCHANGE_PSK_ENABLED)
		PSK_TAG,
#endif
	};

	err = setsockopt(fd, SOL_TLS, TLS_SEC_TAG_LIST,
			 sec_tag_list, sizeof(sec_tag_list));
	if (err < 0) {
		LOG_ERR("Failed to set TCP secure option (%d)", -errno);
		return -errno;
	}

	if (!srv) {
		err = setsockopt(fd, SOL_TLS, TLS_HOSTNAME,
				 TLS_PEER_HOSTNAME, sizeof(TLS_PEER_HOSTNAME));
		if (err < 0) {
			LOG_ERR("Failed to set TLS_HOSTNAME option (%d)",
				-errno);
			return -errno;
		}
	}

	LOG_INF("Set TLS socket options for %d", fd);

	return 0;
#else
	LOG_ERR("CONFIG_NET_SOCKETS_SOCKOPT_TLS not enabled");
	return -ENOTSUP;
#endif
}

SHELL_STATIC_SUBCMD_SET_CREATE(sock_commands,
	SHELL_CMD(new, NULL, "'sock new <family inet|inet6> <type stream|dgram>"
			     "<proto tcp|tls_1_2>' Create a new socket",
		  cmd_sock_new),
	SHELL_CMD(connect, NULL, "'sock connect <fd> <ip>:<port> or [<ipv6>]:<port>' "
			     "Connect a socket",
		  cmd_sock_connect),
	SHELL_CMD(bind, NULL, "'sock bind <fd> <ip>:<port> or [<ipv6>]:<port>' "
			     "Connect a socket",
		  cmd_sock_bind),
	SHELL_CMD(listen, NULL, "'sock listen <fd> <max client>' "
			     "Make a socket listen",
		  cmd_sock_listen),
	SHELL_CMD(accept, NULL, "'sock accept <fd>' "
			     "Accept an incoming connection",
		  cmd_sock_accept),
	SHELL_CMD(close, NULL, "'sock close <fd>' "
			     "Close a socket",
		  cmd_sock_close),
	SHELL_CMD(send, NULL, "'sock send <fd> <data>' "
			     "Send data",
		  cmd_sock_send),
	SHELL_CMD(recv, NULL, "'sock recv <fd>' "
			     "Receive data",
		  cmd_sock_recv),
	SHELL_CMD(poll, NULL, "'sock poll <timeout> <in|inout|out> <nfd> <fd1> <fd2> ..<fdn>' "
			     "Poll file descriptors",
		  cmd_sock_poll),
	SHELL_CMD(tlsopt, NULL, "'sock tlsopt <fd> <srv|cli>' "
			     "Set TLS related options",
		  cmd_sock_tlsopt),

	SHELL_SUBCMD_SET_END
);

SHELL_CMD_REGISTER(sock, &sock_commands, "Sockets commands", NULL);

void main(void)
{

#if defined(CONFIG_NET_SOCKETS_SOCKOPT_TLS)
	int err;

#if defined(SIGNED_CERTS)
	err = tls_credential_add(CERTIFICATE_TAG,
				 TLS_CREDENTIAL_CA_CERTIFICATE,
				 ca_certificate,
				 sizeof(ca_certificate));
	if (err < 0) {
		LOG_ERR("Failed to register CA certificate: %d", err);
		return;
	}
#endif

	err = tls_credential_add(CERTIFICATE_TAG,
				 TLS_CREDENTIAL_SERVER_CERTIFICATE,
				 server_certificate,
				 sizeof(server_certificate));
	if (err < 0) {
		LOG_ERR("Failed to register public certificate: %d", err);
		return;
	}


	err = tls_credential_add(CERTIFICATE_TAG,
				 TLS_CREDENTIAL_PRIVATE_KEY,
				 private_key, sizeof(private_key));
	if (err < 0) {
		LOG_ERR("Failed to register private key: %d", err);
		return;
	}

#if defined(CONFIG_MBEDTLS_KEY_EXCHANGE_PSK_ENABLED)
	err = tls_credential_add(PSK_TAG,
				TLS_CREDENTIAL_PSK,
				psk,
				sizeof(psk));
	if (err < 0) {
		LOG_ERR("Failed to register PSK: %d", err);
		return;
	}
	err = tls_credential_add(PSK_TAG,
				TLS_CREDENTIAL_PSK_ID,
				psk_id,
				sizeof(psk_id) - 1);
	if (err < 0) {
		LOG_ERR("Failed to register PSK ID: %d", err);
		return;
	}
#endif

#endif

}
```

## src/certificate.h
```c
/*
 * Copyright (c) 2020 Léonard Bise
 *
 * SPDX-License-Identifier: Apache-2.0
 */

#ifndef __CERTIFICATE_H__
#define __CERTIFICATE_H__

#define CERTIFICATE_TAG 1
#define PSK_TAG 2

#define TLS_PEER_HOSTNAME "localhost"

#if !defined(SIGNED_CERTS)
static const unsigned char server_certificate[] = {
#include "echo-apps-cert.der.inc"
};

/* This is the private key in pkcs#8 format. */
static const unsigned char private_key[] = {
#include "echo-apps-key.der.inc"
};

#else

static const unsigned char ca_certificate[] = {
#include "ca.der.inc"
};

static const unsigned char server_certificate[] = {
#include "server.der.inc"
};

/* This is the private key in pkcs#8 format. */
static const unsigned char private_key[] = {
#include "server_privkey.der.inc"
};
#endif

#if defined(CONFIG_MBEDTLS_KEY_EXCHANGE_PSK_ENABLED)
#include CONFIG_NET_SAMPLE_PSK_HEADER_FILE
#endif

#endif /* __CERTIFICATE_H__ */
```
